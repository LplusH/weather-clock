// 本文件由 tools/make_font.py 自动生成，请不要手改。
// 字集来源：UI 固定文案 + cache/ 里的歌词 + catalog.json 的歌名歌手
// 字号 12px，共 494 字，位图 11856 字节（每字 24 字节）
//
// 用法：drawCN(u8g2, x, y, '好') 或 drawCNText(u8g2, x, y, "好景不會")
#pragma once
#include <Arduino.h>
#include <U8g2lib.h>

#define CN_W 12
#define CN_H 12
#define CN_BYTES_PER_GLYPH 24
#define CN_COUNT 494

static const uint16_t cn_cp[CN_COUNT] PROGMEM = {
  0x4E00, 0x4E01, 0x4E09, 0x4E0A, 0x4E0B, 0x4E0D, 0x4E16, 0x4E2D, 0x4E4B, 0x4E5F, 0x4E8B, 0x4E8C,
  0x4E8D, 0x4E91, 0x4E94, 0x4EAE, 0x4EBA, 0x4ECA, 0x4ED6, 0x4EE3, 0x4EFB, 0x4EFD, 0x4F1A, 0x4F34,
  0x4F3C, 0x4F46, 0x4F4D, 0x4F4E, 0x4F4F, 0x4F55, 0x4F60, 0x4F7F, 0x4F86, 0x4FE1, 0x500B, 0x5011,
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  0x9EDE, 0x9F8D,
};

static const uint8_t cn_bitmap[] PROGMEM = {
  0x00, 0x00, 0x00, 0x00, 0x00, 0x00, 0x00, 0x00, 0x00, 0x00, 0x00, 0x00, 0xFF, 0xF0, 0x00, 0x00,
  0x00, 0x00, 0x00, 0x00, 0x00, 0x00, 0x00, 0x00, 0x00, 0x00, 0xFF, 0xF0, 0x02, 0x00, 0x02, 0x00,
  0x02, 0x00, 0x02, 0x00, 0x02, 0x00, 0x02, 0x00, 0x02, 0x00, 0x02, 0x00, 0x02, 0x00, 0x1E, 0x00,
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  0x2B, 0xE0, 0xFC, 0x20, 0x47, 0xE0, 0x7E, 0x00, 0x47, 0xE0, 0x7E, 0x00, 0x46, 0x10, 0x5F, 0xF0,
};

// 查表：返回位图在 cn_bitmap 里的偏移，找不到返回 -1
inline int cnFind(uint16_t cp) {
  int lo = 0, hi = CN_COUNT - 1;
  while (lo <= hi) {
    int mid = (lo + hi) >> 1;
    uint16_t v = pgm_read_word(&cn_cp[mid]);
    if (v == cp) return mid * CN_BYTES_PER_GLYPH;
    if (v < cp) lo = mid + 1; else hi = mid - 1;
  }
  return -1;
}

// 垂直裁剪窗口：滚动的歌词只在视口内绘制
// 用法：cnClipTop = 32; cnClipBot = 63;  ...画字...; cnClipTop = -32768; cnClipBot = 32767;
static int16_t cnClipTop = -32768;
static int16_t cnClipBot =  32767;

// 画一个汉字；返回 true 表示字库里有这个字
inline bool drawCN(U8G2 &u8g2, int x, int y, uint16_t cp) {
  int off = cnFind(cp);
  if (off < 0) return false;
  for (int r = 0; r < CN_H; r++) {
    int gy = y + r;
    if (gy < cnClipTop || gy > cnClipBot) continue;
    uint16_t bits = ((uint16_t)pgm_read_byte(&cn_bitmap[off + r * 2]) << 8)
                  | pgm_read_byte(&cn_bitmap[off + r * 2 + 1]);
    if (!bits) continue;
    for (int c = 0; c < CN_W; c++) {
      if (bits & (0x8000 >> c)) u8g2.drawPixel(x + c, gy);
    }
  }
  return true;
}

// 画一串 UTF-8 汉字，返回画完后下一个字的 x 坐标
inline int drawCNText(U8G2 &u8g2, int x, int y, const char *s) {
  while (*s) {
    uint16_t cp; uint8_t b = (uint8_t)*s;
    if (b < 0x80) { cp = b; s += 1; }
    else if ((b & 0xE0) == 0xC0) { cp = ((b & 0x1F) << 6) | (s[1] & 0x3F); s += 2; }
    else if ((b & 0xF0) == 0xE0) { cp = ((b & 0x0F) << 12) | ((s[1] & 0x3F) << 6) | (s[2] & 0x3F); s += 3; }
    else { s += 1; continue; }
    if (!drawCN(u8g2, x, y, cp)) {
      // 字库里没有：画一个空心方块占位，方便一眼看出缺字
      u8g2.drawFrame(x + 1, y + 1, CN_W - 2, CN_H - 2);
    }
    x += CN_W;
  }
  return x;
}
